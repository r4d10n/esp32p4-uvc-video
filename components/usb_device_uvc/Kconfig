## components/usb_device_uvc/Kconfig
```kconfig
menu "USB Device UVC"

    config TUSB_VID
        hex "USB Device VID"
        default 0x303A
    config TUSB_PID
        hex "USB Device PID"
        default 0x8000
    config TUSB_MANUFACTURER
        string "USB Device Manufacturer"
        default "Espressif"
    config TUSB_PRODUCT
        string "Product Name"
        default "ESP32-P4 UVC Webcam"
    config TUSB_SERIAL_NUM
        string "Serial Number"
        default "12345678"

    choice TINYUSB_RHPORT
        prompt "TinyUSB Root Port"
        default TINYUSB_RHPORT_HS if IDF_TARGET_ESP32P4
        default TINYUSB_RHPORT_FS
        help
            USB PHY Controller selection: HS (USB OTG2.0 PHY for HighSpeed)

        config TINYUSB_RHPORT_HS
            depends on IDF_TARGET_ESP32P4
            bool "High Speed"

        config TINYUSB_RHPORT_FS
            bool "Full Speed"
    endchoice

    menu "UVC Task Config"
        config UVC_TINYUSB_TASK_PRIORITY
            int "TinyUSB task priority"
            default 24
            range 1 25

        config UVC_TINYUSB_TASK_CORE
            int "TinyUSB task core (-1=no affinity, 0=CPU0, 1=CPU1)"
            default 1
            range -1 1

        config UVC_CAM1_TASK_PRIORITY
            int "Video task priority"
            default 23
            range 1 25

        config UVC_CAM1_TASK_CORE
            int "Video task core (-1=no affinity, 0=CPU0, 1=CPU1)"
            default 0
            range -1 1
    endmenu

endmenu
```

## main/Kconfig.projbuild
```kconfig
menu "UVC Webcam Configuration"

    menu "ISP Color Profile"
        choice ISP_DEFAULT_PROFILE_CHOICE
            prompt "Default ISP color temperature profile"
            default ISP_PROFILE_DAYLIGHT
            help
                Select the default ISP color correction profile applied at camera start.
                Each profile contains a Color Correction Matrix and White Balance gains
                tuned for a specific lighting condition (from RPi libcamera OV5647 calibration).

            config ISP_PROFILE_TUNGSTEN
                bool "Tungsten (2873K)"
            config ISP_PROFILE_INDOOR_WARM
                bool "Indoor-Warm (3725K)"
            config ISP_PROFILE_FLUORESCENT
                bool "Fluorescent (5095K)"
            config ISP_PROFILE_DAYLIGHT
                bool "Daylight (6015K)"
            config ISP_PROFILE_CLOUDY
                bool "Cloudy (6865K)"
            config ISP_PROFILE_SHADE
                bool "Shade (7600K)"
        endchoice

        config ISP_DEFAULT_PROFILE_INDEX
            int
            default 0 if ISP_PROFILE_TUNGSTEN
            default 1 if ISP_PROFILE_INDOOR_WARM
            default 2 if ISP_PROFILE_FLUORESCENT
            default 3 if ISP_PROFILE_DAYLIGHT
            default 4 if ISP_PROFILE_CLOUDY
            default 5 if ISP_PROFILE_SHADE
    endmenu

    menu "MJPEG Settings"
        config UVC_JPEG_QUALITY
            int "JPEG compression quality"
            default 80
            range 1 100
            help
                JPEG compression quality (1=worst, 100=best).
    endmenu

    menu "H.264 Settings"
        config UVC_H264_BITRATE
            int "H.264 bitrate (bps)"
            default 1000000
            range 25000 2500000
            help
                H.264 encoder target bitrate in bits per second.

        config UVC_H264_I_PERIOD
            int "H.264 I-frame period"
            default 30
            range 1 120
            help
                Number of frames between I-frames.

        config UVC_H264_MIN_QP
            int "H.264 minimum QP"
            default 25
            range 0 51
            help
                H.264 minimum quantization parameter (lower = better quality).

        config UVC_H264_MAX_QP
            int "H.264 maximum QP"
            default 50
            range 0 51
            help
                H.264 maximum quantization parameter (higher = more compression).
    endmenu

    menu "Ethernet / RTSP"
        choice ETH_IP_MODE
            prompt "Ethernet IP address mode"
            default ETH_IP_STATIC
            help
                Select whether to use a static IP address or DHCP for Ethernet.

            config ETH_IP_STATIC
                bool "Static IP"
            config ETH_IP_DHCP
                bool "DHCP"
        endchoice

        config ETH_STATIC_IP
            string "Static IP address"
            default "192.168.0.200"
            depends on ETH_IP_STATIC
            help
                Static IPv4 address for the Ethernet interface.

        config ETH_STATIC_NETMASK
            string "Netmask"
            default "255.255.255.0"
            depends on ETH_IP_STATIC
            help
                Subnet mask for the Ethernet interface.

        config ETH_STATIC_GATEWAY
            string "Gateway"
            default "192.168.0.1"
            depends on ETH_IP_STATIC
            help
                Default gateway for the Ethernet interface.

        config ETH_RTSP_PORT
            int "RTSP server port"
            default 554
            range 1 65535
            help
                TCP port for the RTSP server.

        config RTSP_H264_BITRATE
            int "RTSP H.264 bitrate (bps)"
            default 8000000
            range 500000 20000000
            help
                H.264 target bitrate for RTSP streaming.
                Recommended: 4-8 Mbps for 1080p over 100Mbps Ethernet.

        config RTSP_H264_I_PERIOD
            int "RTSP H.264 I-frame period (GOP size)"
            default 10
            range 1 120
            help
                Frames between IDR frames for RTSP.
                Lower = faster seek/channel-switch, higher = better compression.
                10 = IDR every 333ms at 30fps (good latency/quality balance).

        config RTSP_H264_MIN_QP
            int "RTSP H.264 minimum QP"
            default 20
            range 0 51
            help
                Lower QP = higher quality IDR frames. 20 is good for 1080p.

        config RTSP_H264_MAX_QP
            int "RTSP H.264 maximum QP"
            default 38
            range 0 51
            help
                Higher QP = more compression on P-frames.
                38 preserves detail at 1080p. 50 is visibly blocky.
    endmenu

endmenu
```

## sdkconfig.defaults
```kconfig
# Camera sensor — OV5647 at 1920x1080 RAW10 30fps
CONFIG_CAMERA_OV5647=y
CONFIG_CAMERA_OV5647_MIPI_RAW8_800X800_50FPS=n
CONFIG_CAMERA_OV5647_MIPI_RAW10_1920X1080_30FPS=y
CONFIG_CAMERA_OV5647_MIPI_DEFAULT_FMT_RAW10_1920X1080_30FPS=y

# Video devices
CONFIG_ESP_VIDEO_ENABLE_MIPI_CSI_VIDEO_DEVICE=y
CONFIG_ESP_VIDEO_ENABLE_HW_H264_VIDEO_DEVICE=y
CONFIG_ESP_VIDEO_ENABLE_HW_JPEG_VIDEO_DEVICE=y
CONFIG_ESP_VIDEO_ENABLE_ISP_VIDEO_DEVICE=y
CONFIG_ESP_VIDEO_ENABLE_ISP_PIPELINE_CONTROLLER=y
CONFIG_ISP_PIPELINE_CONTROLLER_TASK_STACK_USE_PSRAM=y

# PSRAM (32MB hex mode on Olimex board)
CONFIG_SPIRAM=y
CONFIG_SPIRAM_MODE_HEX=y
CONFIG_SPIRAM_SPEED_200M=y

# Performance
CONFIG_COMPILER_OPTIMIZATION_PERF=y
CONFIG_IDF_EXPERIMENTAL_FEATURES=y

# USB Device - High Speed
CONFIG_TINYUSB_RHPORT_HS=y
CONFIG_TINYUSB_VIDEO_STREAMING_IFS=1

# USB task: high priority on CPU1, video task on CPU0
CONFIG_UVC_TINYUSB_TASK_PRIORITY=24
CONFIG_UVC_TINYUSB_TASK_CORE=1
CONFIG_UVC_CAM1_TASK_PRIORITY=23
CONFIG_UVC_CAM1_TASK_CORE=0

# FreeRTOS: 1000Hz tick for minimal scheduling latency
CONFIG_FREERTOS_HZ=1000

# Runtime stats for per-core CPU usage monitoring
CONFIG_FREERTOS_USE_TRACE_FACILITY=y
CONFIG_FREERTOS_GENERATE_RUN_TIME_STATS=y
CONFIG_FREERTOS_VTASKLIST_INCLUDE_COREID=y

# VFS: increase max drivers (camera uses ~6, LWIP needs 1 more)
CONFIG_VFS_MAX_COUNT=12

# Ethernet (Olimex ESP32-P4 onboard IP101GR PHY via internal EMAC)
CONFIG_ETH_ENABLED=y
CONFIG_ETH_USE_ESP32_EMAC=y
```

## sdkconfig.defaults.esp32p4
```kconfig
# Camera sensor
CONFIG_CAMERA_OV5647=y

# Video devices
CONFIG_ESP_VIDEO_ENABLE_MIPI_CSI_VIDEO_DEVICE=y
CONFIG_ESP_VIDEO_ENABLE_HW_H264_VIDEO_DEVICE=y
CONFIG_ESP_VIDEO_ENABLE_HW_JPEG_VIDEO_DEVICE=y
CONFIG_ESP_VIDEO_ENABLE_ISP_VIDEO_DEVICE=y

# PSRAM (32MB hex mode on Olimex board)
CONFIG_SPIRAM=y
CONFIG_SPIRAM_MODE_HEX=y
CONFIG_SPIRAM_SPEED_200M=y

# Performance
CONFIG_COMPILER_OPTIMIZATION_PERF=y
CONFIG_IDF_EXPERIMENTAL_FEATURES=y

# USB Device - High Speed
CONFIG_TINYUSB_RHPORT_HS=y
CONFIG_TINYUSB_VIDEO_STREAMING_IFS=1
```
